## config/west.yml
```yaml
manifest:
  remotes:
    - name: zmkfirmware
      url-base: https://github.com/zmkfirmware
    - name: cormoran
      url-base: https://github.com/cormoran
    - name: caksoylar  # <-- RGB LED
      url-base: https://github.com/caksoylar
    - name: kot149
      url-base: https://github.com/kot149
  projects:
    - name: zmk
      remote: cormoran
      revision: 3931facea7507151a53f209ca4f8a717fa6bd400 # v0.3-branch+dya
      import: app/west.yml
    - name: zmk-rgbled-widget
      remote: caksoylar
      revision: 8756cb7b8114069fa3c25c6f6c990f24988fceff # v0.3
    - name: zmk-layout-shift
      remote: kot149
      revision: dd1414b43739ac70a6c6dc36ff378b70824a6bc6 # v2
  self:
    path: config
```
